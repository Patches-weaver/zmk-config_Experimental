/* source keypos definitions */
#include "../zmk-nodefree-config/keypos_def/keypos_30keys.h"

/* source the main keymap */
#include "base.keymap"

// /* use 5-column layout for Zen */
// / { chosen { zmk,matrix_transform = &five_column_transform; }; };
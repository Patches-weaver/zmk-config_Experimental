#include <behaviors.dtsi>
#include <dt-bindings/zmk/keys.h>
#include <dt-bindings/zmk/bt.h>
#include <dt-bindings/zmk/mouse.h>

#if CONFIG_WIRELESS
    #define _BT_SEL_KEYS_ &bt BT_SEL 0 &bt BT_SEL 1 &bt BT_SEL 2 &bt BT_SEL 3 &bt BT_CLR
#else
    #define _BT_SEL_KEYS_ &trans &trans &trans &trans &trans
#endif

#include "../zmk-nodefree-config/helper.h"

// Layer Definitions
#define DEF 0
#define NAV 1
#define FN 2
#define NUM 3
#define SYS 4
#define UC 5
#define MOUSE 6
#define SYM 7
#define APPS 8
#define WIN 9
#define TOOLS 10

#define XXX &none
#define ___ &trans

// Global Settings
#define QUICK_TAP_MS 175

&sk {
    release-after-ms = <900>;
    quick-release;
};

&sl {
    ignore-modifiers;
};

< {
    flavor = "balanced";
    tapping-term-ms = <200>;
    quick-tap-ms = <QUICK_TAP_MS>;
};

// Homerow Mods
#define KEYS_L LT0 LT1 LT2 LT3 LT4 LM0 LM1 LM2 LM3 LM4 LB0 LB1 LB2
#define KEYS_R RT0 RT1 RT2 RT3 RT4 RM0 RM1 RM2 RM3 RM4 RB0 RB1 RB2
#define THUMBS LH1 LH0 RH0 RH1

#define MAKE_HRM(NAME, HOLD, TAP, TRIGGER_POS) \
    / { \
        behaviors { \
            NAME: NAME { \
                #binding-cells = <0>; \
                flavor = "balanced"; \
                tapping-term-ms = <280>; \
                quick-tap-ms = <QUICK_TAP_MS>; \
                require-prior-idle-ms = <150>; \
                bindings = <HOLD>, <TAP>; \
                hold-trigger-key-positions = <TRIGGER_POS>; \
                hold-trigger-on-release; \
            }; \
        }; \
    };

MAKE_HRM(hml, &kp, &kp, KEYS_R THUMBS)
MAKE_HRM(hmr, &kp, &kp, KEYS_L THUMBS)
MAKE_HRM(hml_repeat, &kp, &key_repeat, KEYS_R THUMBS)
MAKE_HRM(hmr_lpar_lt, &kp, &lpar_lt, KEYS_L THUMBS)
MAKE_HRM(hmr_rpar_gt, &kp, &rpar_gt, KEYS_L THUMBS)

// Nav Cluster
#define MT_CORE \
    flavor = "tap-preferred"; \
    tapping-term-ms = <220>; \
    quick-tap-ms = <220>; \
    hold-trigger-key-positions = <0>;

&mt { MT_CORE };
/ { behaviors {
    mt_home: mt_home { #binding-cells = <2>; bindings = <&masked_home>, <&kp>; MT_CORE };
    mt_end: mt_end { #binding-cells = <2>; bindings = <&masked_end>, <&kp>; MT_CORE };
}; };

#define NAV_LEFT  &mt_home 0 LEFT
#define NAV_RIGHT &mt_end 0 RIGHT
#define NAV_UP    &mt LC(HOME) UP
#define NAV_DOWN  &mt LC(END) DOWN
#define NAV_BSPC  &mt LC(BSPC) BSPC
#define NAV_DEL   &mt LC(DEL) DEL

#define MASK_MODS(NAME, MODS, BINDING) \
    / { behaviors { \
        NAME: NAME { #binding-cells = <0>; bindings = <BINDING>, <BINDING>; mods = <MODS>; }; \
    }; };
MASK_MODS(masked_home, (MOD_LCTL), &kp HOME)
MASK_MODS(masked_end, (MOD_LCTL), &kp END)

// Smart Behaviors
/ { behaviors {
    smart_shft: smart_shft {
        #binding-cells = <0>;
        bindings = <&sk LSHFT>, <&caps_word>;
        mods = <(MOD_LSFT)>;
    };
    smart_num: smart_num {
        #binding-cells = <2>;
        flavor = "balanced";
        tapping-term-ms = <200>;
        quick-tap-ms = <QUICK_TAP_MS>;
        bindings = <&mo>, <&num_dance>;
    };
    num_dance: num_dance {
        #binding-cells = <0>;
        tapping-term-ms = <200>;
        bindings = <&num_word>, <&sl NUM>;
    };
    smart_mouse: smart_mouse {
        #binding-cells = <0>;
        bindings = <&tog MOUSE>, <&none>, <&tog MOUSE>;
        ignored-key-positions = <LT1 LT3 RT1 RT2 RT3 RM1 RM2 RM3 RH0 RH1>;
        ignored-layers = <MOUSE>;
    };
    swapper: swapper {
        #binding-cells = <0>;
        bindings = <&kt LALT>, <&kp TAB>, <&kt LALT>;
        ignored-key-positions = <LT2>;
    };
    sls: sls {
        #binding-cells = <1>;
        release-after-ms = <1000>;
        bindings = <&uc_shift>;
        ignore-modifiers;
    };
    uc_shift: uc_shift {
        #binding-cells = <0>;
        wait-ms = <0>;
        tap-ms = <1>;
        bindings = <¯o_press &mo UC &kp LSHFT>, <¯o_pause_for_release>, <¯o_release &mo UC &kp LSHFT>;
    };
}; };

&caps_word { /delete-property/ ignore-modifiers; };
&num_word { layers = <NUM>; continue-list = <BSPC DEL DOT COMMA PLUS MINUS STAR FSLH EQUAL>; };
#define SMART_NUM &smart_num NUM 0

// Simple Morphs
#define SIMPLE_MORPH(NAME, MOD, BINDING1, BINDING2) \
    / { behaviors { \
        NAME: NAME { #binding-cells = <0>; mods = <(MOD_L##MOD|MOD_R##MOD)>; bindings = <BINDING1>, <BINDING2>; }; \
    }; };
SIMPLE_MORPH(comma_morph, SFT, &kp COMMA, &comma_inner_morph)
SIMPLE_MORPH(comma_inner_morph, CTL, &kp SEMICOLON, &kp LESS_THAN)
SIMPLE_MORPH(dot_morph, SFT, &kp DOT, &dot_inner_morph)
SIMPLE_MORPH(dot_inner_morph, CTL, &kp COLON, &kp GREATER_THAN)
SIMPLE_MORPH(qexcl, SFT, &kp QMARK, &kp EXCL)
SIMPLE_MORPH(lpar_lt, SFT, &kp LPAR, &kp LT)
SIMPLE_MORPH(rpar_gt, SFT, &kp RPAR, &kp GT)

// Layer-Tap Space
/ { behaviors {
    lt_spc: lt_spc {
        #binding-cells = <2>;
        flavor = "balanced";
        tapping-term-ms = <200>;
        quick-tap-ms = <QUICK_TAP_MS>;
        bindings = <&mo>, <&spc_morph>;
    };
    spc_morph: spc_morph {
        #binding-cells = <0>;
        mods = <(MOD_LSFT|MOD_RSFT)>;
        bindings = <&kp SPACE>, <&dot_spc>;
    };
    dot_spc: dot_spc {
        #binding-cells = <0>;
        wait-ms = <0>;
        tap-ms = <5>;
        bindings = <&kp DOT &kp SPACE &sk LSHFT>;
    };
    bs_del: bs_del {
        #binding-cells = <0>;
        bindings = <&kp BSPC>, <&kp DEL>;
        mods = <(MOD_LSFT|MOD_RSFT)>;
        keep-mods = <MOD_RSFT>;
    };
    copy_cut: copy_cut {
        #binding-cells = <0>;
        tapping-term-ms = <250>;
        bindings = <&kp LC(C)>, <&kp LC(X)>;
    };
    win_sleep: win_sleep {
        #binding-cells = <0>;
        wait-ms = <500>;
        tap-ms = <50>;
        bindings = <&kp LG(X) &kp U &kp S>;
    };
}; };

// Aliases
#define CANCEL      &kp K_CANCEL
#define DSK_PREV    &hmr RSHFT LG(LC(LEFT))
#define DSK_NEXT    &hmr LALT LG(LC(RIGHT))
#define PIN_WIN     &kp LG(LC(LS(Q)))
#define PIN_APP     &kp LG(LC(LS(A)))
#define DSK_MGR     &kp LA(GRAVE)
#define VOL_DOWN    &hmr LCTRL C_VOL_DN
#define UNDO        &kp LC(Z)
#define REDO        &kp LC(Y)
#define VPASTE      &kp LC(V)

// App Aliases
#define TDIST       &kp LG(LA(S))
#define TDIST_QADD  &kp LG(LA(Q))
#define EVTHNG      &kp LC(LA(H))
#define KEYPIR      &kp LA(SPACE)
#define LINE        &kp LC(LA(L))
#define CODA        &kp LC(LA(C))
#define FFOX        &kp LC(LA(F))
#define NotePad     &kp LC(LA(N))
#define VSCODE      &kp LC(LA(V))
#define XYPlorer    &kp LC(LA(Y))
#define Word        &kp LC(LA(W))
#define Emeditor    &kp LC(LA(M))
#define Spacemacs   &kp LC(LA(E))
#define Discord     &kp LC(LA(D))

// Window Management
#define WIN_MAX     &kp LG(UP)
#define WIN_MIN     &kp LG(DOWN)
#define WIN_MIN_ALL &kp LG(M)
#define WIN_MON_L   &kp LG(LS(LEFT))
#define WIN_MON_R   &kp LG(LS(RIGHT))
#define SHW_DSKTP   &kp LG(D)
#define WIN_FOCUS   &kp LG(HOME)
#define SNIP        &kp LG(LS(S))
#define SNIPOCR     &kp LG(LS(T))
#define WIN_CLOSE   &kp LA(F4)

// Keypad
#define DIV         &kp KP_DIVIDE
#define MUL         &kp KP_MULTIPLY
#define MIN         &kp KP_SUBTRACT
#define PLS         &kp KP_PLUS

// Layers
ZMK_CONDITIONAL_LAYER(FN NUM, SYS)

// Layers
ZMK_CONDITIONAL_LAYER(FN NUM, SYS)

ZMK_LAYER(base,
// ╭─────────────┬─────────────┬─────────────┬─────────────┬─────────────╮  ╭─────────────┬─────────────┬─────────────┬─────────────┬─────────────╮
     &kp C         &kp B         < TOOLS H   &kp G         < NAV K       &comma_morph   &dot_morph    &kp SQT       &kp J         &kp M        
// ├─────────────┼─────────────┼─────────────┼─────────────┼─────────────┤  ├─────────────┼─────────────┼─────────────┼─────────────┼─────────────┤
     &hml LGUI P   &hml LALT S   &hml LCTRL N  &hml LSHFT T  < NUM V       < APPS MINUS &hmr RSHFT A  &hmr LCTRL E  &hmr LALT I   &hmr LGUI W  
// ├─────────────┼─────────────┼─────────────┼─────────────┼─────────────┤  ├─────────────┼─────────────┼─────────────┼─────────────┼─────────────┤
                   &kp F         < TOOLS L   < MOUSE D                                  < NUM U     < SYM O     < WIN Y                     
// ╰─────────────┼─────────────┴─────────────┼─────────────┼─────────────┤  ├─────────────┼─────────────┼─────────────┴─────────────┴─────────────╯
                                               < FN RET    < NAV R       <_spc NAV 0  &smart_shft                                          
//                                           ╰─────────────┴─────────────╯  ╰─────────────┴─────────────╯                                          
)

ZMK_LAYER(nav,
// ╭─────────────┬─────────────┬─────────────┬─────────────┬─────────────╮  ╭─────────────┬─────────────┬─────────────┬─────────────┬─────────────╮
     &kp ESC       &kp LS(TAB)   &kp TAB       &kp SPACE     ___           &kp HOME      NAV_BSPC      NAV_UP        NAV_DEL       &kp PG_UP    
// ├─────────────┼─────────────┼─────────────┼─────────────┼─────────────┤  ├─────────────┼─────────────┼─────────────┼─────────────┼─────────────┤
     &sk LGUI      &sk LALT      &sk LCTRL     &sk LSHFT     ___           &kp END       NAV_LEFT      NAV_DOWN      NAV_RIGHT     &kp PG_DN    
// ├─────────────┼─────────────┼─────────────┼─────────────┼─────────────┤  ├─────────────┼─────────────┼─────────────┼─────────────┼─────────────┤
                   ___           &swapper      ___                                       SMART_NUM     &kp LT        &kp GT                     
// ╰─────────────┼─────────────┴─────────────┼─────────────┼─────────────┤  ├─────────────┼─────────────┼─────────────┴─────────────┴─────────────╯
                                               &kp CAPS      ___           ___           CANCEL                                              
//                                           ╰─────────────┴─────────────╯  ╰─────────────┴─────────────╯                                          
)

ZMK_LAYER(fn,
// ╭─────────────┬─────────────┬─────────────┬─────────────┬─────────────╮  ╭─────────────┬─────────────┬─────────────┬─────────────┬─────────────╮
     &kp F12       &kp F7        &kp F8        &kp F9        ©_cut     UNDO          &kp C_PREV    &kp C_VOL_UP  &kp C_NEXT    &win_sleep   
// ├─────────────┼─────────────┼─────────────┼─────────────┼─────────────┤  ├─────────────┼─────────────┼─────────────┼─────────────┼─────────────┤
     &hml LGUI F11 &hml LALT F4  &hml LCTRL F5 &hml LSHFT F6 VPASTE        REDO          DSK_PREV      VOL_DOWN      DSK_NEXT      ___          
// ├─────────────┼─────────────┼─────────────┼─────────────┼─────────────┤  ├─────────────┼─────────────┼─────────────┼─────────────┼─────────────┤
                   &kp F1        &kp F2        &kp F3                                     PIN_APP       PIN_WIN       DSK_MGR                     
// ╰─────────────┼─────────────┴─────────────┼─────────────┼─────────────┤  ├─────────────┼─────────────┼─────────────┴─────────────┴─────────────╯
                                               ___           ___           &kp C_MUTE    &kp C_PP                                            
//                                           ╰─────────────┴─────────────╯  ╰─────────────┴─────────────╯                                          
)

ZMK_LAYER(num,
// ╭─────────────┬─────────────┬─────────────┬─────────────┬─────────────╮  ╭─────────────┬─────────────┬─────────────┬─────────────┬─────────────╮
     ___           &kp N7        &kp N8        &kp N9        ___           ___           &kp KP_DOT    ___           ___           ___          
// ├─────────────┼─────────────┼─────────────┼─────────────┼─────────────┤  ├─────────────┼─────────────┼─────────────┼─────────────┼─────────────┤
     &hml LGUI N0  &hml LALT N4  &hml LCTRL N5 &hml LSHFT N6 &num_word     &kp EQUAL     DIV           MUL           MIN           PLS          
// ├─────────────┼─────────────┼─────────────┼─────────────┼─────────────┤  ├─────────────┼─────────────┼─────────────┼─────────────┼─────────────┤
                   &kp N1        &kp N2        &kp N3                                     ___           ___           ___                     
// ╰─────────────┼─────────────┴─────────────┼─────────────┼─────────────┤  ├─────────────┼─────────────┼─────────────┴─────────────┴─────────────╯
                                               ___           &kp N0        &kp SPACE     &tog NUM                                            
//                                           ╰─────────────┴─────────────╯  ╰─────────────┴─────────────╯                                          
)

ZMK_LAYER(sys,
// ╭─────────────┬─────────────┬─────────────┬─────────────┬─────────────╮  ╭─────────────┬─────────────┬─────────────┬─────────────┬─────────────╮
                   _BT_SEL_KEYS_                               ___           ___           ___           ___           ___          
// ├─────────────┼─────────────┼─────────────┼─────────────┼─────────────┤  ├─────────────┼─────────────┼─────────────┼─────────────┼─────────────┤
     ___           ___           ___           ___           &bootloader   &bootloader   ___           ___           ___           ___          
// ├─────────────┼─────────────┼─────────────┼─────────────┼─────────────┤  ├─────────────┼─────────────┼─────────────┼─────────────┼─────────────┤
                   ___           ___           &sys_reset                               &sys_reset    ___           ___                     
// ╰─────────────┼─────────────┴─────────────┼─────────────┼─────────────┤  ├─────────────┼─────────────┼─────────────┴─────────────┴─────────────╯
                                               ___           ___           ___           ___                                                
//                                           ╰─────────────┴─────────────╯  ╰─────────────┴─────────────╯                                          
)

ZMK_LAYER(uc,
// ╭─────────────┬─────────────┬─────────────┬─────────────┬─────────────╮  ╭─────────────┬─────────────┬─────────────┬─────────────┬─────────────╮
     ___           ___           ___           ___           ___           ___           ___           ___           ___           ___          
// ├─────────────┼─────────────┼─────────────┼─────────────┼─────────────┤  ├─────────────┼─────────────┼─────────────┼─────────────┼─────────────┤
     ___           ___           ___           ___           ___           ___           ___           ___           ___           ___          
// ├─────────────┼─────────────┼─────────────┼─────────────┼─────────────┤  ├─────────────┼─────────────┼─────────────┼─────────────┼─────────────┤
                   ___           ___           ___                                       ___           ___           ___                     
// ╰─────────────┼─────────────┴─────────────┼─────────────┼─────────────┤  ├─────────────┼─────────────┼─────────────┴─────────────┴─────────────╯
                                               ___           ___           ___           ___                                                
//                                           ╰─────────────┴─────────────╯  ╰─────────────┴─────────────╯                                          
)

ZMK_LAYER(mouse,
// ╭─────────────┬─────────────┬─────────────┬─────────────┬─────────────╮  ╭─────────────┬─────────────┬─────────────┬─────────────┬─────────────╮
     ___           ___           ___           ___           ___           ___           U_WH_D        U_MS_U        U_WH_U        ___          
// ├─────────────┼─────────────┼─────────────┼─────────────┼─────────────┤  ├─────────────┼─────────────┼─────────────┼─────────────┼─────────────┤
     ___           ___           ___           ___           ___           ___           U_MS_L        U_MS_D        U_MS_R        ___          
// ├─────────────┼─────────────┼─────────────┼─────────────┼─────────────┤  ├─────────────┼─────────────┼─────────────┼─────────────┼─────────────┤
                   ___           ___           ___                                       ___           ___           ___                     
// ╰─────────────┼─────────────┴─────────────┼─────────────┼─────────────┤  ├─────────────┼─────────────┼─────────────┴─────────────┴─────────────╯
                                               ___           ___           U_BTN2        U_BTN1                                              
//                                           ╰─────────────┴─────────────╯  ╰─────────────┴─────────────╯                                          
)

ZMK_LAYER(sym,
// ╭─────────────┬─────────────┬─────────────┬─────────────┬─────────────╮  ╭─────────────┬─────────────┬─────────────┬─────────────┬─────────────╮
     &kp EXCL      &kp AT_SIGN   &kp HASH      &kp DLLR      &kp PRCNT     &kp CARET     &kp AMPS      &kp SEMI      &kp COLON     &kp QMARK    
// ├─────────────┼─────────────┼─────────────┼─────────────┼─────────────┤  ├─────────────┼─────────────┼─────────────┼─────────────┼─────────────┤
     &kp TILDE     &kp EQUAL     &kp MINUS     &kp FSLH      &kp SLASH     &kp BSLH      &kp LSHFT     &kp LCTRL     &kp LALT      &kp LGUI     
// ├─────────────┼─────────────┼─────────────┼─────────────┼─────────────┤  ├─────────────┼─────────────┼─────────────┼─────────────┼─────────────┤
                   &kp UNDER     &kp PLUS      &kp ASTRK                               &kp PIPE      &kp LT        &kp GT                     
// ╰─────────────┼─────────────┴─────────────┼─────────────┼─────────────┤  ├─────────────┼─────────────┼─────────────┴─────────────┴─────────────╯
                                               ___           ___           ___           ___                                                
//                                           ╰─────────────┴─────────────╯  ╰─────────────┴─────────────╯                                          
)

ZMK_LAYER(apps,
// ╭─────────────┬─────────────┬─────────────┬─────────────┬─────────────╮  ╭─────────────┬─────────────┬─────────────┬─────────────┬─────────────╮
     CODA          ___           EVTHNG        TDIST_QADD    ___           ___           ___           ___           ___           Emeditor     
// ├─────────────┼─────────────┼─────────────┼─────────────┼─────────────┤  ├─────────────┼─────────────┼─────────────┼─────────────┼─────────────┤
     ___           SNIP          NotePad       ___           VSCODE        ___           ___           Spacemacs     ___           Word         
// ├─────────────┼─────────────┼─────────────┼─────────────┼─────────────┤  ├─────────────┼─────────────┼─────────────┼─────────────┼─────────────┤
                   FFOX          LINE          Discord                                 ___           SNIPOCR       XYPlorer                    
// ╰─────────────┼─────────────┴─────────────┼─────────────┼─────────────┤  ├─────────────┼─────────────┼─────────────┴─────────────┴─────────────╯
                                               ___           ___           ___           ___                                                
//                                           ╰─────────────┴─────────────╯  ╰─────────────┴─────────────╯                                          
)

ZMK_LAYER(win,
// ╭─────────────┬─────────────┬─────────────┬─────────────┬─────────────╮  ╭─────────────┬─────────────┬─────────────┬─────────────┬─────────────╮
     ___           WIN_CLOSE     WIN_MAX       ___           ___           ___           ___           ___           ___           WIN_MIN_ALL  
// ├─────────────┼─────────────┼─────────────┼─────────────┼─────────────┤  ├─────────────┼─────────────┼─────────────┼─────────────┼─────────────┤
     ___           WIN_MON_L     &swapper      WIN_MON_R     ___           ___           ___           ___           ___           ___          
// ├─────────────┼─────────────┼─────────────┼─────────────┼─────────────┤  ├─────────────┼─────────────┼─────────────┼─────────────┼─────────────┤
                   WIN_FOCUS     WIN_MIN       SHW_DSKTP                               ___           ___           ___                     
// ╰─────────────┼─────────────┴─────────────┼─────────────┼─────────────┤  ├─────────────┼─────────────┼─────────────┴─────────────┴─────────────╯
                                               ___           ___           ___           ___                                                
//                                           ╰─────────────┴─────────────╯  ╰─────────────┴─────────────╯                                          
)

ZMK_LAYER(tools,
// ╭─────────────┬─────────────┬─────────────┬─────────────┬─────────────╮  ╭─────────────┬─────────────┬─────────────┬─────────────┬─────────────╮
     &kp ESC       ©_cut     ___           VPASTE        ___           ___           ___           ___           ___           ___          
// ├─────────────┼─────────────┼─────────────┼─────────────┼─────────────┤  ├─────────────┼─────────────┼─────────────┼─────────────┼─────────────┤
     ___           NAV_BSPC      ___           NAV_DEL       ___           ___           ___           ___           ___           ___          
// ├─────────────┼─────────────┼─────────────┼─────────────┼─────────────┤  ├─────────────┼─────────────┼─────────────┼─────────────┼─────────────┤
                   UNDO          ___           REDO                                    ___           ___           ___                     
// ╰─────────────┼─────────────┴─────────────┼─────────────┼─────────────┤  ├─────────────┼─────────────┼─────────────┴─────────────┴─────────────╯
                                               ___           ___           ___           ___                                                
//                                           ╰─────────────┴─────────────╯  ╰─────────────┴─────────────╯                                          
)

// ZMK_LAYER(mouse,
// ╭─────────────┬─────────────┬─────────────┬─────────────┬─────────────╮  ╭─────────────┬─────────────┬─────────────┬─────────────┬─────────────╮
//     ___           ___           ___           ___           ___              ___           U_WH_D        U_MS_U         U_WH_U       ___          
// ├─────────────┼─────────────┼─────────────┼─────────────┼─────────────┤  ├─────────────┼─────────────┼─────────────┼─────────────┼─────────────┤
//   ___           ___           ___           ___           ___              ___           U_MS_L        U_MS_D         U_MS_R       ___          
// ├─────────────┼─────────────┼─────────────┼─────────────┼─────────────┤  ├─────────────┼─────────────┼─────────────┼─────────────┼─────────────┤
//                   ___           ___           ___                                          ___           ___            ___        
// ╰─────────────┼─────────────┴─────────────┼─────────────┼─────────────┤  ├─────────────┼─────────────┼─────────────┴─────────────┴─────────────╯
//                                               ___           ___              U_BTN2        U_BTN1                                                 
//                                           ╰─────────────┴─────────────╯  ╰─────────────┴─────────────╯                                          
//)

//ZMK_LAYER(uc,
// ╭─────────────┬─────────────┬─────────────┬─────────────┬─────────────╮  ╭─────────────┬─────────────┬─────────────┬─────────────┬─────────────╮
//     ___           ___           ___           ___           ___              ___           ___           ___           ___           ___          
// ├─────────────┼─────────────┼─────────────┼─────────────┼─────────────┤  ├─────────────┼─────────────┼─────────────┼─────────────┼─────────────┤
//     ___           ___           ___           ___           ___              ___           ___           ___           ___           ___          
// ├─────────────┼─────────────┼─────────────┼─────────────┼─────────────┤  ├─────────────┼─────────────┼─────────────┼─────────────┼─────────────┤
//                   ___           ___           ___                                          ___           ___           ___           
// ╰─────────────┼─────────────┴─────────────┼─────────────┼─────────────┤  ├─────────────┼─────────────┼─────────────┴─────────────┴─────────────╯
//                                               ___           ___              ___           ___                                                    
//                                           ╰─────────────┴─────────────╯  ╰─────────────┴─────────────╯                                          
//)

// ZMK_LAYER(BLANK,
// ╭─────────────┬─────────────┬─────────────┬─────────────┬─────────────╮  ╭─────────────┬─────────────┬─────────────┬─────────────┬─────────────╮
//      ___           ___           ___           ___           ___              ___           ___           ___           ___           ___          
// ├─────────────┼─────────────┼─────────────┼─────────────┼─────────────┤  ├─────────────┼─────────────┼─────────────┼─────────────┼─────────────┤
//      ___           ___           ___           ___           ___              ___           ___           ___           ___           ___          
// ├─────────────┼─────────────┼─────────────┼─────────────┼─────────────┤  ├─────────────┼─────────────┼─────────────┼─────────────┼─────────────┤
//                    ___           ___           ___                                          ___           ___           ___           
// ╰─────────────┼─────────────┴─────────────┼─────────────┼─────────────┤  ├─────────────┼─────────────┼─────────────┴─────────────┴─────────────╯
//                                                ___           ___              ___           ___                                                    
//                                           ╰─────────────┴─────────────╯  ╰─────────────┴─────────────╯                                          
// )

/* vim: set ft=c tw=174: */